## config/boards/shields/capricorn30/Kconfig.defconfig
```kconfig
# Copyright (c) 2022 The ZMK Contributors
# SPDX-License-Identifier: MIT

if SHIELD_CAPRICORN30

config ZMK_KEYBOARD_NAME
    default "Capricorn30"

endif
```

## config/boards/shields/capricorn30/Kconfig.shield
```kconfig
# Copyright (c) 2022 The ZMK Contributors
# SPDX-License-Identifier: MIT

config SHIELD_CAPRICORN30
   def_bool $(shields_list_contains,capricorn30)
```
